## arch/arm/mach-s5p4418/Kconfig
```kconfig
if ARCH_S5P4418

config TARGET_IBOX4418
    bool "Ibox4418 board"

config SYS_SOC
    default "s5p4418"

source "board/ibox4418/Kconfig"

endif
```

## board/ibox4418/Kconfig
```kconfig
if TARGET_IBOX4418

config  SYS_BOARD
        default "ibox4418"

config  SYS_CONFIG_NAME
        default "ibox4418"

config  SYS_I2C_S5P4418_SPEED
        int
        default 100000

config  SYS_I2C_S5P4418_SLAVE
        hex
        default 0xFE

endif
```

## board/samsung/rp4412/Kconfig
```kconfig
if TARGET_RP4412

    config SYS_BOARD
            default "rp4412"

    config SYS_VENDOR
            default "samsung"

    config SYS_CONFIG_NAME
            default "rp4412"

endif
```

## configs/ibox4418_defconfig
```kconfig
CONFIG_ARM=y
CONFIG_ARCH_S5P4418=y
CONFIG_TARGET_IBOX4418=y

# CONFIG_CMD_BDI is not set

# CONFIG_CMD_ELF is not set
# CONFIG_CMD_IMI is not set
# CONFIG_CMD_IMLS is not set
# CONFIG_CMD_XIMG is not set

# CONFIG_CMD_FLASH is not set
# CONFIG_CMD_NET is not set
CONFIG_SYS_PROMPT="Ibox4418 # "
```
